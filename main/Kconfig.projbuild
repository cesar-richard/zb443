## main/Kconfig.projbuild
```kconfig
menu "ZB433 Configuration"

    config ZB433_WIFI_SSID
        string "Wi-Fi SSID"
        default "YOUR_WIFI_SSID"
        help
            Wi-Fi network name

    config ZB433_WIFI_PASS
        string "Wi-Fi Password"
        default "YOUR_WIFI_PASSWORD"
        help
            Wi-Fi network password

    config ZB433_DEFAULT_OTA_URL
        string "Default OTA URL"
        default "http://homeassistant.local:8123/local/zb433.bin"
        help
            Default URL for OTA updates

endmenu
```

## sdkconfig.defaults
```kconfig
# Target
CONFIG_IDF_TARGET="esp32c6"
# Flash size
CONFIG_ESPTOOLPY_FLASHSIZE_4MB=y

# Partition table
CONFIG_PARTITION_TABLE_CUSTOM=y
CONFIG_PARTITION_TABLE_CUSTOM_FILENAME="partitions.csv"
CONFIG_PARTITION_TABLE_FILENAME="partitions.csv"

# Logs - Debug mode to troubleshoot steering issues
CONFIG_LOG_DEFAULT_LEVEL_DEBUG=y
CONFIG_LOG_MAXIMUM_LEVEL_DEBUG=y

# Disable ALL optional components
CONFIG_BT_ENABLED=n
CONFIG_ESP_WIFI_ENABLED=n
CONFIG_ESP_HTTPS_OTA_ALLOW_HTTP=n

# Zigbee
CONFIG_ZB_ENABLED=y
CONFIG_ZB_ROLE_ROUTER=y
CONFIG_ZB_MAX_CHILDREN=8

# Compiler optimizations - Release mode
CONFIG_COMPILER_OPTIMIZATION_SIZE=y
CONFIG_COMPILER_OPTIMIZATION_ASSERTIONS_DISABLE=y
CONFIG_COMPILER_OPTIMIZATION_CHECKS_SILENT=y

# FreeRTOS - Minimal
CONFIG_FREERTOS_HZ=1000
CONFIG_FREERTOS_UNICORE=n

# Disable memory protection (may cause issues)
# CONFIG_ESP_SYSTEM_PMP_IDRAM_SPLIT=n
# CONFIG_ESP_SYSTEM_RTC_FAST_MEM_AS_HEAP_DEPCHECK=n
# CONFIG_ESP_SYSTEM_ALLOW_RTC_FAST_MEM_AS_HEAP=n

# No Wi-Fi needed for this minimal router
```
